/dts-v1/;

/ {
	compatible = "allwinner,sun50i-h616";

	fragment@0 {
		target = <0xffffffff>;

		__overlay__ {
			pinctrl-names = "default";
			pinctrl-0 = <0xffffffff>;
			status = "okay";
			clock-frequency = <10000>;
		};
	};

	__fixups__ {
		i2c2 = "/fragment@0:target:0";
		i2c2_ph_pins = "/fragment@0/__overlay__:pinctrl-0:0";
	};
};
